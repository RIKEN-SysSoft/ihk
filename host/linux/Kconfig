## host/linux/Kconfig
```kconfig
config AAL
	bool "Enable Accelerator Abstraction Layer"
	default y

config AAL_DEBUG
	bool "Enable debug output for AAL"
    depends on AAL
	default n
```

## linux/core/Kconfig
```kconfig
config IHK
	bool "Enable Accelerator Abstraction Layer"
	default y

config IHK_DEBUG
	bool "Enable debug output for IHK"
    depends on IHK
	default n
```
